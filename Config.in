## printutils/Config.in
```kconfig
#
# For a description of the syntax of this configuration file,
# see scripts/kbuild/config-language.txt.
#

menu "Print Utilities"

config LPD
	bool "lpd"
	default n
	depends on PLATFORM_POSIX
	help
	  lpd is a print spooling daemon.

config LPR
	bool "lpr"
	default n
	depends on PLATFORM_POSIX
	help
	  lpr sends files (or standard input) to a print spooling daemon.

config LPQ
	bool "lpq"
	default n
	depends on PLATFORM_POSIX
	help
	  lpq is a print spool queue examination and manipulation program.

endmenu
```
